#include "../behavior_keymap.dtsi"
#include <dt-bindings/zmk/kscan_mock.h>

&kscan {
    events = <
        ZMK_MOCK_PRESS(0,1,1000)
        ZMK_MOCK_PRESS(1,1,1000)
        ZMK_MOCK_RELEASE(1,1,1000)
        ZMK_MOCK_RELEASE(0,1,1000)
    >;
};
