## src/Kconfig
```kconfig
config ZMK_LAYER_REPORT
    bool "Layer Report HID"
    default n
    help
      Enable layer state reporting via a vendor-defined HID report.
      Sends a 2-byte bitmask of active layers to the host.

if ZMK_LAYER_REPORT

config ZMK_LAYER_REPORT_BLE
    bool "BLE transport for layer report"
    default y
    depends on ZMK_BLE

config ZMK_LAYER_REPORT_USB
    bool "USB transport for layer report"
    default y
    depends on USB_DEVICE_STACK

config ZMK_LAYER_REPORT_USAGE_PAGE
    hex "HID Usage Page for layer report"
    default 0xFF42

config ZMK_LAYER_REPORT_REPORT_ID
    int "HID Report ID for layer report"
    default 32

endif # ZMK_LAYER_REPORT
```
